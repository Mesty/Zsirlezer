/**
  ******************************************************************************
  * File Name          : main.c
  * Description        : Main program body
  ******************************************************************************
  *
  * COPYRIGHT(c) 2017 STMicroelectronics
  *
  * Redistribution and use in source and binary forms, with or without modification,
  * are permitted provided that the following conditions are met:
  *   1. Redistributions of source code must retain the above copyright notice,
  *      this list of conditions and the following disclaimer.
  *   2. Redistributions in binary form must reproduce the above copyright notice,
  *      this list of conditions and the following disclaimer in the documentation
  *      and/or other materials provided with the distribution.
  *   3. Neither the name of STMicroelectronics nor the names of its contributors
  *      may be used to endorse or promote products derived from this software
  *      without specific prior written permission.
  *
  * THIS SOFTWARE IS PROVIDED BY THE COPYRIGHT HOLDERS AND CONTRIBUTORS "AS IS"
  * AND ANY EXPRESS OR IMPLIED WARRANTIES, INCLUDING, BUT NOT LIMITED TO, THE
  * IMPLIED WARRANTIES OF MERCHANTABILITY AND FITNESS FOR A PARTICULAR PURPOSE ARE
  * DISCLAIMED. IN NO EVENT SHALL THE COPYRIGHT HOLDER OR CONTRIBUTORS BE LIABLE
  * FOR ANY DIRECT, INDIRECT, INCIDENTAL, SPECIAL, EXEMPLARY, OR CONSEQUENTIAL
  * DAMAGES (INCLUDING, BUT NOT LIMITED TO, PROCUREMENT OF SUBSTITUTE GOODS OR
  * SERVICES; LOSS OF USE, DATA, OR PROFITS; OR BUSINESS INTERRUPTION) HOWEVER
  * CAUSED AND ON ANY THEORY OF LIABILITY, WHETHER IN CONTRACT, STRICT LIABILITY,
  * OR TORT (INCLUDING NEGLIGENCE OR OTHERWISE) ARISING IN ANY WAY OUT OF THE USE
  * OF THIS SOFTWARE, EVEN IF ADVISED OF THE POSSIBILITY OF SUCH DAMAGE.
  *
  ******************************************************************************
  */
/* Includes ------------------------------------------------------------------*/
#include "main.h"
#include "stm32f4xx_hal.h"
#include "adc.h"
#include "dma.h"
#include "spi.h"
#include "tim.h"
#include "usart.h"
#include "gpio.h"
#include "math.h"

/* USER CODE BEGIN Includes */
#include "stdbool.h"


//Defineok
//Vonalszam
#define NINCSVONAL 10
#define EGYVONAL 1
#define KETVONAL 2
#define HAROMVONAL 3
#define VONALHIBA 15

//Vonalobjektumok
#define GYORSITO 5
#define LASSITO 6
#define SIMA_VEZETOVONAL 13

//Sebszab
#define MEREDEKSEG_GYORSITASNAL 2000
#define MEREDEKSEG_LASSITASNAL 2000
#define ALAPJEL_MEREDEKSEG_GYORSITASNAL 3000
#define ALAPJEL_MEREDEKSEG_LASSITASNAL 3000

//Allapotteres szabalyozok
#define NORMAL 1
#define GYORSITO_SZAB 2

#define ELSOKOR 1
#define MASODIKKOR 2
#define HARMADIKKOR 3


/* USER CODE END Includes */

/* Private variables ---------------------------------------------------------*/

/* USER CODE BEGIN PV */
/* Private variables ---------------------------------------------------------*/

float atan_lut[5400] = {
	 -2233.6111,
	 -2233.155, -2232.6986, -2232.2421, -2231.7854, -2231.3285, -2230.8714, -2230.414, -2229.9565, -2229.4988, -2229.0408,
	 -2228.5827, -2228.1243, -2227.6658, -2227.207, -2226.7481, -2226.2889, -2225.8295, -2225.3699, -2224.9102, -2224.4502,
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	 2229.4085, 2229.8662, 2230.3238, 2230.7812, 2231.2384, 2231.6953, 2232.1521, 2232.6086, 2233.065, 2233.5247};

//GLOBALISAK
//Sharp ADC
volatile bool SHARP_FRONT_valid=false;
uint16_t SHARP_FRONT_raw =0;
int32_t SHARP_FRONT_filtered=0;
int32_t SHARP_FRONT_array[20]={0,0,0,0,0,0,0,0,0,0,0,0,0,0,0,0,0,0,0,0};

//LABRANGATO
volatile uint32_t actualmotorinput=0;
volatile uint32_t previousmotorinput=0;
bool stop_deadman = false;

//Motor
uint32_t motorpulsePWM=0;
bool stop = false;
bool stop_cel = false;

//Utemezo
volatile uint32_t timestamp;
volatile bool tick=false;

//Encoder
volatile int32_t actualencoderval=0;
int32_t encoder_aktualis=0;
int32_t encoder_elozo=0;
int32_t encoder_diff=0;
int32_t velocity;
HAL_TIM_StateTypeDef encoder_state;
int32_t encoder_diff_WMA=0;
int32_t encoder_diff_array[4]={0,0,0,0};

//Vonalszenzor UART
volatile bool vonalszenzor_uzenetjott=false;
uint8_t uzenetarray[5]={0,0,0,0,0};
uint16_t pozicio_elso=1600;
uint16_t pozicio_masodik=1200;
uint8_t vonaltipus=EGYVONAL;
int16_t orientacio=0;
uint32_t szervoPWM;
uint8_t vonalminta=SIMA_VEZETOVONAL;
uint8_t lassito_szakaszok_szama=0;

//Safety car
bool safetycar_aktiv=true;
char string[20];
bool stop_safetycar=false;
bool elso_gyorsito=true;
uint8_t kor=ELSOKOR;

int32_t mmpersec_sebesseg=0;
bool fekeztunk_mar=true;
bool eltolt_gyorsulas=false;
uint32_t start_tick=0;
uint32_t start_tick_lassito=0;
uint8_t allapotteres_szabalyozo=NORMAL;

/* USER CODE END PV */

/* Private function prototypes -----------------------------------------------*/
void SystemClock_Config(void);
void Error_Handler(void);

/* USER CODE BEGIN PFP */
/* Private function prototypes -----------------------------------------------*/
void Motorkezeles();
void Vonalszenzorkezeles_uartfogadas();
void allapotteres_szabalyozo_kanyar_kijarat(uint16_t* pozicio, int16_t* orientacio, int32_t* sebesseg, uint32_t* PWMeredmeny);
void allapotteres_szabalyozo_default(uint16_t* pozicio, int16_t* orientacio, int32_t* sebesseg, uint32_t* PWMeredmeny);
void WMAfilter(int32_t* filteredval, int32_t* newelement, int32_t* array, uint32_t filter_depth);
void Encoder_beolvasas();
void Safety_car_old();
void Safety_car_P();
void sebessegszabalyozo(int32_t mmpersec);
void fekezo_sebessegszabalyozo(int32_t mmpersec);
void vonalminta_felismeres();
void lassitora_mitcsinalunk();
void gyorsitora_mitcsinalunk();

/* USER CODE END PFP */

/* USER CODE BEGIN 0 */

void HAL_ADC_ConvCpltCallback(ADC_HandleTypeDef* hadc)
{
	if (hadc->Instance == ADC1)
		SHARP_FRONT_valid = true; //eleg egyet beolvasni
}
void HAL_TIM_IC_CaptureCallback(TIM_HandleTypeDef* htim)
{
	if (htim->Instance == TIM4)
	{
		previousmotorinput = actualmotorinput;
		actualmotorinput = HAL_TIM_ReadCapturedValue(&htim4,TIM_CHANNEL_1);
		__HAL_TIM_SET_COUNTER(&htim4,0);
	}
}
void HAL_TIM_PeriodElapsedCallback(TIM_HandleTypeDef *htim)
{
	if(htim->Instance == TIM7)
	{
		timestamp++;
		actualencoderval=HAL_TIM_ReadCapturedValue(&htim2, TIM_CHANNEL_1);
		tick = true;
	}
}

void HAL_UART_RxCpltCallback(UART_HandleTypeDef *huart)
{
	if (huart->Instance ==USART1)
	{
		vonalszenzor_uzenetjott=true;
	}
}
//Uart neha csinal random ORE-t
void HAL_UART_ErrorCallback(UART_HandleTypeDef *huart)
{
	if (huart->Instance ==USART1)
	{
	    if (huart->ErrorCode == HAL_UART_ERROR_ORE)//Néha random overrun hiba, ekkor kinullázuk
	    {
	            // remove the error condition
	            huart->ErrorCode = HAL_UART_ERROR_NONE;
	            // set the correct state, so that the UART_RX_IT works correctly
	            huart->gState = HAL_UART_STATE_BUSY_RX;
	    }
	}
}


/* USER CODE END 0 */

int main(void)

{

  /* USER CODE BEGIN 1 */

  /* USER CODE END 1 */

  /* MCU Configuration----------------------------------------------------------*/

  /* Reset of all peripherals, Initializes the Flash interface and the Systick. */
  HAL_Init();

  /* Configure the system clock */
  SystemClock_Config();

  /* Initialize all configured peripherals */
  MX_GPIO_Init();
  MX_DMA_Init();
  MX_ADC1_Init();
  MX_SPI1_Init();
  MX_TIM1_Init();
  MX_TIM2_Init();
  MX_TIM8_Init();
  MX_UART4_Init();
  MX_UART5_Init();
  MX_USART1_UART_Init();
  MX_TIM6_Init();
  MX_USART2_UART_Init();
  MX_TIM4_Init();
  MX_TIM7_Init();

  /* USER CODE BEGIN 2 */

  HAL_TIMEx_PWMN_Start(&htim1, TIM_CHANNEL_2);
  HAL_TIMEx_PWMN_Start(&htim8, TIM_CHANNEL_3);
  __HAL_TIM_SET_COMPARE(&htim8, TIM_CHANNEL_3, 6932);
  HAL_TIM_Base_Start_IT(&htim7);
  HAL_TIM_IC_Start_IT(&htim4,TIM_CHANNEL_1);
  HAL_TIM_Encoder_Start(&htim2, TIM_CHANNEL_1);

  //Vonalszenzortol uzenetek fogadasa
  HAL_UART_Receive_DMA(&huart1, uzenetarray, 5);

  //Alap sebesseg megadasa  D
 // motorpulsePWM = 7300;
  mmpersec_sebesseg=700;

  /* USER CODE END 2 */

  /* Infinite loop */
  /* USER CODE BEGIN WHILE */
  while (1)
  {
  /* USER CODE END WHILE */

  /* USER CODE BEGIN 3 */


	  if(lassito_szakaszok_szama==18)
		  stop_cel=true;
	  if(lassito_szakaszok_szama > 5 && lassito_szakaszok_szama < 10)
		  kor=MASODIKKOR;
	  if(lassito_szakaszok_szama > 9 )
		  kor=HARMADIKKOR;

	  if(vonalszenzor_uzenetjott==true) //3ms-onkent kapunk uzenetet
	  {
		  Vonalszenzorkezeles_uartfogadas();
	  }
	  Motorkezeles();

	  vonalminta_felismeres();

	  if(tick) //10ms
	  {
		  HAL_ADC_Start_DMA(&hadc1, (uint32_t*) &SHARP_FRONT_raw, 1); //SHARP front adc elinditasa

		  Encoder_beolvasas();

		  while(!SHARP_FRONT_valid);//Ha mar letelt az ad konverzio ideje, akkor szurjuk a kapott AD erteket
		  WMAfilter(&SHARP_FRONT_filtered,(int32_t*)&(SHARP_FRONT_raw),SHARP_FRONT_array,20);
		  if(safetycar_aktiv)
		  {
			  Safety_car_P();
		  }



		  if(eltolt_gyorsulas)
		  {
			  	safetycar_aktiv=false;
				if(start_tick==0)
					start_tick=timestamp;

				if(timestamp-start_tick > 60)
				{
					mmpersec_sebesseg=3050;
					if(MASODIKKOR)
						mmpersec_sebesseg=3750;
					if(HARMADIKKOR)
						mmpersec_sebesseg=3900;
					start_tick=0;
					eltolt_gyorsulas=false;
				}
		  }

		  if(fekeztunk_mar==false )
		  {
				if(start_tick_lassito==0)
					start_tick_lassito=timestamp;

				if(timestamp-start_tick_lassito > 85) //50
				{
					mmpersec_sebesseg=820; //muszaj hogy levegyuk, hogy bevegye a kanyart
					if(MASODIKKOR)
						mmpersec_sebesseg=950;
					if(HARMADIKKOR)
						mmpersec_sebesseg=1100;
					start_tick_lassito=0;
					fekeztunk_mar=true;
				}
				else
				{
					  if (encoder_diff > 3)
						  motorpulsePWM=4000;
					  else
						  motorpulsePWM=6932;
				}
		  }
		  else
		  {
			  sebessegszabalyozo(mmpersec_sebesseg);
		  }


		  tick=false;
	  }
  }
  /* USER CODE END 3 */

}

/** System Clock Configuration
*/
void SystemClock_Config(void)
{

  RCC_OscInitTypeDef RCC_OscInitStruct;
  RCC_ClkInitTypeDef RCC_ClkInitStruct;

    /**Configure the main internal regulator output voltage 
    */
  __HAL_RCC_PWR_CLK_ENABLE();

  __HAL_PWR_VOLTAGESCALING_CONFIG(PWR_REGULATOR_VOLTAGE_SCALE1);

    /**Initializes the CPU, AHB and APB busses clocks 
    */
  RCC_OscInitStruct.OscillatorType = RCC_OSCILLATORTYPE_HSE;
  RCC_OscInitStruct.HSEState = RCC_HSE_ON;
  RCC_OscInitStruct.PLL.PLLState = RCC_PLL_ON;
  RCC_OscInitStruct.PLL.PLLSource = RCC_PLLSOURCE_HSE;
  RCC_OscInitStruct.PLL.PLLM = 4;
  RCC_OscInitStruct.PLL.PLLN = 180;
  RCC_OscInitStruct.PLL.PLLP = RCC_PLLP_DIV2;
  RCC_OscInitStruct.PLL.PLLQ = 2;
  RCC_OscInitStruct.PLL.PLLR = 2;
  if (HAL_RCC_OscConfig(&RCC_OscInitStruct) != HAL_OK)
  {
    Error_Handler();
  }

    /**Activate the Over-Drive mode 
    */
  if (HAL_PWREx_EnableOverDrive() != HAL_OK)
  {
    Error_Handler();
  }

    /**Initializes the CPU, AHB and APB busses clocks 
    */
  RCC_ClkInitStruct.ClockType = RCC_CLOCKTYPE_HCLK|RCC_CLOCKTYPE_SYSCLK
                              |RCC_CLOCKTYPE_PCLK1|RCC_CLOCKTYPE_PCLK2;
  RCC_ClkInitStruct.SYSCLKSource = RCC_SYSCLKSOURCE_PLLCLK;
  RCC_ClkInitStruct.AHBCLKDivider = RCC_SYSCLK_DIV1;
  RCC_ClkInitStruct.APB1CLKDivider = RCC_HCLK_DIV4;
  RCC_ClkInitStruct.APB2CLKDivider = RCC_HCLK_DIV2;

  if (HAL_RCC_ClockConfig(&RCC_ClkInitStruct, FLASH_LATENCY_5) != HAL_OK)
  {
    Error_Handler();
  }

    /**Configure the Systick interrupt time 
    */
  HAL_SYSTICK_Config(HAL_RCC_GetHCLKFreq()/1000);

    /**Configure the Systick 
    */
  HAL_SYSTICK_CLKSourceConfig(SYSTICK_CLKSOURCE_HCLK);

  /* SysTick_IRQn interrupt configuration */
  HAL_NVIC_SetPriority(SysTick_IRQn, 0, 0);
}

/* USER CODE BEGIN 4 */
void Vonalszenzorkezeles_uartfogadas()
{
	  //UART uzenet fogadasa a vonalszenzortol
	  pozicio_elso = uzenetarray[0] + uzenetarray[1]*0xff;
	  pozicio_masodik = uzenetarray[2] + uzenetarray[3]*0xff;
	  vonaltipus=uzenetarray[4];
	  orientacio=pozicio_elso-pozicio_masodik;
	  //if(allapotteres_szabalyozo==NORMAL)
		//  allapotteres_szabalyozo_default(&pozicio_elso, &orientacio, &velocity, &szervoPWM);
	 // else if (allapotteres_szabalyozo==GYORSITO_SZAB)
		  allapotteres_szabalyozo_kanyar_kijarat(&pozicio_elso, &orientacio, &velocity, &szervoPWM);
	  __HAL_TIM_SET_COMPARE(&htim1, TIM_CHANNEL_2, szervoPWM);
	  vonalszenzor_uzenetjott=false;
}

void Motorkezeles()
{
	  if(((actualmotorinput < previousmotorinput) ? actualmotorinput : previousmotorinput) < 4000)
		  stop_deadman = true;
	  else
		  stop_deadman = false;
	  if (stop_cel || stop_safetycar)
		  stop = true;
	  else
		  stop = false;

	  if(timestamp > 500)
	  {
		  if (!stop)
			  __HAL_TIM_SET_COMPARE(&htim8, TIM_CHANNEL_3, motorpulsePWM);
		  else if (encoder_diff > 3)
			  __HAL_TIM_SET_COMPARE(&htim8, TIM_CHANNEL_3, 4000);
		  else
			  __HAL_TIM_SET_COMPARE(&htim8, TIM_CHANNEL_3, 6932);
	  }
}

void allapotteres_szabalyozo_kanyar_kijarat(uint16_t* pozicio, int16_t* orientacio, int32_t* sebesseg, uint32_t* PWMeredmeny)
{
	float sebesseg_a_szabalyozonak = 0.0;
	sebesseg_a_szabalyozonak=((float)*sebesseg)/1000.0; //[m/s]

	if(*sebesseg < 2000)
		//uj
		//*PWMeredmeny = (uint32_t) (-296.0805*(2*((float)*pozicio)-3300)/(1325.5776*(0.1143*sebesseg_a_szabalyozonak+0.8)*(0.1143*sebesseg_a_szabalyozonak+0.8))+(-0.441-0.18517*sebesseg_a_szabalyozonak)*atan_lut[*orientacio+2300]/((0.1143*sebesseg_a_szabalyozonak+0.8)*(0.1143*sebesseg_a_szabalyozonak+0.8))+5930);
		*PWMeredmeny = (uint32_t) (-296.0805*(2*((float)*pozicio)-3300)/(1325.5776*(0.1*sebesseg_a_szabalyozonak+0.95)*(0.1*sebesseg_a_szabalyozonak+0.95))+(-0.684-0.162*sebesseg_a_szabalyozonak)*atan_lut[*orientacio+2300]/((0.1*sebesseg_a_szabalyozonak+0.95)*(0.1*sebesseg_a_szabalyozonak+0.95))+5930);


		//lassu, kanyarkijarat
		//*PWMeredmeny = (uint32_t) (-296.0805*(2*((float)*pozicio)-3300)/(1325.5776*(0.11112*sebesseg_a_szabalyozonak+0.3981)*(0.11112*sebesseg_a_szabalyozonak+0.3981))+(0.21008-0.18001*sebesseg_a_szabalyozonak)*atan_lut[*orientacio+2300]/((0.11112*sebesseg_a_szabalyozonak+0.3981)*(0.11112*sebesseg_a_szabalyozonak+0.3981))+5930);
	else
		//uj
		*PWMeredmeny = (uint32_t) (-296.0805*(2*((float)*pozicio)-3300)/(1325.5776*(0.573*sebesseg_a_szabalyozonak+0.004)*(0.573*sebesseg_a_szabalyozonak+0.004))+(0.84852-0.92826*sebesseg_a_szabalyozonak)*atan_lut[*orientacio+2300]/((0.573*sebesseg_a_szabalyozonak+0.004)*(0.573*sebesseg_a_szabalyozonak+0.004))+5930);

		//gyors
		//*PWMeredmeny = (uint32_t) (-296.0805*(2*((float)*pozicio)-3300)/(1325.5776*(0.6568*sebesseg_a_szabalyozonak-0.284)*(0.6568*sebesseg_a_szabalyozonak-0.284))+(1.3151-1.064*sebesseg_a_szabalyozonak)*atan_lut[*orientacio+2300]/((00.6568*sebesseg_a_szabalyozonak-0.284)*(0.6568*sebesseg_a_szabalyozonak-0.284))+5930);

	if(*PWMeredmeny > 7250)
		*PWMeredmeny=7250;
	else if(*PWMeredmeny < 4610)
		*PWMeredmeny=4610;
}
void allapotteres_szabalyozo_default(uint16_t* pozicio, int16_t* orientacio, int32_t* sebesseg, uint32_t* PWMeredmeny)
{
	float sebesseg_a_szabalyozonak = 0.0;
	sebesseg_a_szabalyozonak=((float)*sebesseg)/1000.0; //[m/s]

	if(*sebesseg < 2000)
		//lassu, kanyar alatt
		*PWMeredmeny = (uint32_t) (-296.0805*(2*((float)*pozicio)-3300)/(1325.5776*(0.0857*sebesseg_a_szabalyozonak+0.85)*(0.0857*sebesseg_a_szabalyozonak+0.85))+(-0.522-0.13883*sebesseg_a_szabalyozonak)*atan_lut[*orientacio+2300]/((0.0857*sebesseg_a_szabalyozonak+0.85)*(0.0857*sebesseg_a_szabalyozonak+0.85))+5930);

	else
		//gyors
		*PWMeredmeny = (uint32_t) (-296.0805*(2*((float)*pozicio)-3300)/(1325.5776*(0.6167*sebesseg_a_szabalyozonak-0.0833)*(0.6167*sebesseg_a_szabalyozonak-0.0833))+(0.98995-0.99905*sebesseg_a_szabalyozonak)*atan_lut[*orientacio+2300]/((0.6167*sebesseg_a_szabalyozonak-0.0833)*(0.6167*sebesseg_a_szabalyozonak-0.0833))+5930);
	if(*PWMeredmeny > 7250)
		*PWMeredmeny=7250;
	else if(*PWMeredmeny < 4610)
		*PWMeredmeny=4610;
}
void WMAfilter(int32_t* filteredval, int32_t* newelement, int32_t* array, uint32_t filter_depth)
{
	*filteredval=0;
	int32_t coeffsum=0;

	for(int i=0; i<filter_depth-1; i++)
	{
		array[i]=array[i+1];
		*filteredval=*filteredval+array[i]*(i+1);
		coeffsum+=(i+1);
	}
	array[filter_depth-1]=*newelement;
	*filteredval=*filteredval+array[filter_depth-1]*(filter_depth);
	coeffsum+=(filter_depth);
	*filteredval=*filteredval/coeffsum;
}
void Encoder_beolvasas() //!!!Fix idokozonkent kell hivni, szamit ra a fuggveny (10ms)
{
	  encoder_state = HAL_TIM_Encoder_GetState(&htim2);
	  if(encoder_state==HAL_TIM_STATE_READY)
	  {
		  encoder_aktualis=actualencoderval*2;//valami rossza az enkoderrel, valszeg nem kapjuk meg az egyik channelt
		  encoder_diff=encoder_aktualis-encoder_elozo;
		  velocity=encoder_diff*10000/743;//velocity=((encoderdiff*10000)/743); //v[mm/s]
		  encoder_elozo=encoder_aktualis;
		  WMAfilter(&encoder_diff_WMA, &encoder_diff, encoder_diff_array, 4);
	  }
	  else
	  {
		  //error handling...
	  }
}
void Safety_car_old()
{
	static uint32_t stop_kezdete=0;
	if(SHARP_FRONT_filtered > 2000) //35cm
	{
		stop_safetycar=true;
		stop_kezdete=timestamp;
	}
	else if(SHARP_FRONT_filtered > 1200) //55cm
	{
		motorpulsePWM=7270;
	}
	else if(SHARP_FRONT_filtered > 800) //85cm
	{
		motorpulsePWM=7300;
	}
	else if(SHARP_FRONT_filtered < 600) //95cm
		motorpulsePWM=7360;


	if(SHARP_FRONT_filtered < 2000 && timestamp-stop_kezdete > 25)  //250 msig allunk
	{
		stop_safetycar=false;
	}
	if(pozicio_elso > 1900 || pozicio_elso < 1300) //Kanyari max sebesseg
		motorpulsePWM=7300;

	if((timestamp%10)==1)
	{
		/*sprintf(&string,"..........\r\n");
		sprintf(&string,"%d\t%d",SHARP_FRONT_filtered, velocity);
		HAL_UART_Transmit_DMA(&huart2, &string, sizeof(string)*sizeof(uint8_t));*/
	}
}

void Safety_car_P()
{
	mmpersec_sebesseg= (1400-((SHARP_FRONT_raw-600)*9)/7);
	if(mmpersec_sebesseg > 1400)
		mmpersec_sebesseg=1400;
	if(mmpersec_sebesseg < -100)
		mmpersec_sebesseg = -100;
	if(pozicio_elso > 1900 || pozicio_elso < 1300) //Kanyari max sebesseg
		mmpersec_sebesseg=600;
}

void sebessegszabalyozo(int32_t mmpersec)
{

	// Belso valtozok
	int32_t alapjel = mmpersec;
	static int32_t elozo_alapjel = 0;
	static float beavatkozo_jel = 0;
	static float elozo_beavatkozo_jel = 0;
	static float pozitiv_visszacsatolas = 0;
	float FOXBORO_bemeno_jel = 0;

	// Szabalyozas
	// Szabalyozasi algoritmus
	pozitiv_visszacsatolas = 0.99288*pozitiv_visszacsatolas+0.0071168*beavatkozo_jel;
	FOXBORO_bemeno_jel = 0.9029*(mmpersec-velocity)+pozitiv_visszacsatolas;
	// Beavatkozo szerv telites kezelese
	if(FOXBORO_bemeno_jel > 1500)
		beavatkozo_jel = 1500;
	else if(FOXBORO_bemeno_jel < -4000)
		beavatkozo_jel = -4000;
	else
		beavatkozo_jel = FOXBORO_bemeno_jel;
	// Inverz statikus nemlinearitas
	if(beavatkozo_jel > 0)
	{
		if((0 < beavatkozo_jel) && (beavatkozo_jel <= 112.0907))
			beavatkozo_jel = 200+0.89213*beavatkozo_jel;
		else if((112.0907 < beavatkozo_jel) && (beavatkozo_jel <= 350.2835))
			beavatkozo_jel = 300+0.41983*(beavatkozo_jel-112.0907);
		else if((350.2835 < beavatkozo_jel) && (beavatkozo_jel <= 560.4536))
			beavatkozo_jel = 400+0.47581*(beavatkozo_jel-350.2835);
		else if((560.4536 < beavatkozo_jel) && (beavatkozo_jel <= 756.6123))
			beavatkozo_jel = 500+0.50979*(beavatkozo_jel-560.4536);
		else if((756.6123 < beavatkozo_jel) && (beavatkozo_jel <= 910.737))
			beavatkozo_jel = 600+0.64883*(beavatkozo_jel-756.6123);
	}
	// Beavatkozo jel kiadasa
	motorpulsePWM = (uint32_t) (beavatkozo_jel+6932);
	// Integratorok feltoltese
	elozo_alapjel = alapjel;
	elozo_beavatkozo_jel = beavatkozo_jel;
}

void fekezo_sebessegszabalyozo(int32_t mmpersec)
{

	// Belso valtozok
	int32_t alapjel = mmpersec;
	static int32_t elozo_alapjel = 0;
	static float beavatkozo_jel = 0;
	static float elozo_beavatkozo_jel = 0;
	static float pozitiv_visszacsatolas = 0;
	float FOXBORO_bemeno_jel = 0;

	// Szabalyozas
	// Szabalyozasi algoritmus
	pozitiv_visszacsatolas = 0.99288*pozitiv_visszacsatolas+0.0071168*beavatkozo_jel;
	FOXBORO_bemeno_jel = 40.0*(mmpersec-velocity)+pozitiv_visszacsatolas;
	// Beavatkozo szerv telites kezelese
	if(FOXBORO_bemeno_jel > 1500)
		beavatkozo_jel = 1500;
	else if(FOXBORO_bemeno_jel < -4000)
		beavatkozo_jel = -4000;
	else
		beavatkozo_jel = FOXBORO_bemeno_jel;
	// Inverz statikus nemlinearitas
	if(beavatkozo_jel > 0)
	{
		if((0 < beavatkozo_jel) && (beavatkozo_jel <= 112.0907))
			beavatkozo_jel = 200+0.89213*beavatkozo_jel;
		else if((112.0907 < beavatkozo_jel) && (beavatkozo_jel <= 350.2835))
			beavatkozo_jel = 300+0.41983*(beavatkozo_jel-112.0907);
		else if((350.2835 < beavatkozo_jel) && (beavatkozo_jel <= 560.4536))
			beavatkozo_jel = 400+0.47581*(beavatkozo_jel-350.2835);
		else if((560.4536 < beavatkozo_jel) && (beavatkozo_jel <= 756.6123))
			beavatkozo_jel = 500+0.50979*(beavatkozo_jel-560.4536);
		else if((756.6123 < beavatkozo_jel) && (beavatkozo_jel <= 910.737))
			beavatkozo_jel = 600+0.64883*(beavatkozo_jel-756.6123);
	}
	// Beavatkozo jel kiadasa
	motorpulsePWM = (uint32_t) (beavatkozo_jel+6932);
	// Integratorok feltoltese
	elozo_alapjel = alapjel;
	elozo_beavatkozo_jel = beavatkozo_jel;
}

void vonalminta_felismeres()
{
	static bool vonalfigyeles_aktiv=false; //
	static int32_t startpozicio=0;
	static bool voltmaregyvonal=false;
	//static int32_t vonaleszleles_helye=0;
	static bool elso_belepes_lesz_egyvonalba=false;
	static bool elso_belepes_lesz_haromvonalba=true;
	static bool vonalfigyeles_ignoralva = false;
	static uint8_t haromvonalak_szama=0;
	static int32_t haromvonal_kezdete=0;
	static int32_t egyvonal_kezdete=0;

	//Legyen "volt egyvonal" valtozo -> akkor nem lehet lassito

	//bizonyos tavolsag utan mindenkepp kilepni, ha van eredmeny, ha nincs- done


	if(vonalfigyeles_ignoralva==true && (encoder_aktualis-startpozicio > 30000)) //4m utan figyeljuk csak ujra a vonalat
	{
		vonalfigyeles_ignoralva=false;
	}

	if(vonaltipus==HAROMVONAL && vonalfigyeles_aktiv==false && vonalfigyeles_ignoralva==false)
	{
		//csak akkor figyelunk vonalat, ha az elso 3 vonal legalabb 3cm
		if(startpozicio==0) //elso eset
		{
			startpozicio=encoder_aktualis;
		}
		if(encoder_aktualis-startpozicio > 150) //2cm utan elhisszuk hogy van jel
			vonalfigyeles_aktiv=true;
	}
	//startpoz-t nullazni kell ha nincs jel,
	if(vonaltipus==EGYVONAL && vonalfigyeles_aktiv==false && vonalfigyeles_ignoralva==false && startpozicio!=0 && encoder_aktualis-startpozicio > 150)  //2cm
		startpozicio=0;


	if(vonaltipus==HAROMVONAL && vonalfigyeles_aktiv==true && elso_belepes_lesz_haromvonalba==true)
		//Kell meg hosszfigyeles: csak 3cm utan fogadunk el objektumot
	{
		elso_belepes_lesz_haromvonalba=false;
		haromvonal_kezdete=encoder_aktualis;
	}
	if(vonaltipus==HAROMVONAL && vonalfigyeles_aktiv==true && elso_belepes_lesz_haromvonalba==false && encoder_aktualis-haromvonal_kezdete > 150 && haromvonal_kezdete!=0)//2cm
	{
		haromvonalak_szama++;
		elso_belepes_lesz_egyvonalba=true;
		haromvonal_kezdete=0;
	}

	if(vonaltipus==EGYVONAL && vonalfigyeles_aktiv==true && elso_belepes_lesz_egyvonalba==true)
		//Kell meg hosszfigyeles: csak 4cm utan fogadunk el objektumot
	{
		elso_belepes_lesz_egyvonalba=false;
		egyvonal_kezdete=encoder_aktualis;
		voltmaregyvonal=true;
	}
	if(vonaltipus==EGYVONAL && vonalfigyeles_aktiv==true && elso_belepes_lesz_egyvonalba==false && encoder_aktualis-egyvonal_kezdete > 150 && egyvonal_kezdete!=0) //2cm
	{
		elso_belepes_lesz_haromvonalba=true;
		egyvonal_kezdete=0;
	}


	if(vonaltipus==HAROMVONAL && vonalfigyeles_aktiv==true && encoder_aktualis-startpozicio > 1000 && haromvonalak_szama==1 && voltmaregyvonal==false) //legyen inkabb 13 cm //30cm - 2220 utan csak egy osszefuggo 3 vonal: lassito
	{
		vonalminta=LASSITO;
		//reset all
		vonalfigyeles_ignoralva=true;
		vonalfigyeles_aktiv=false;
		haromvonalak_szama=0;
		elso_belepes_lesz_egyvonalba=false;
		elso_belepes_lesz_haromvonalba=true;
		lassito_szakaszok_szama++;
		voltmaregyvonal=false;
		lassitora_mitcsinalunk();
	}

	else if(vonalfigyeles_aktiv==true && encoder_aktualis-startpozicio > 2823 && (haromvonalak_szama==3 || haromvonalak_szama==4) )//38 cm mulva 3 vonal
	{
		vonalminta=GYORSITO;
		//reste all
		vonalfigyeles_ignoralva=true;
		vonalfigyeles_aktiv=false;
		haromvonalak_szama=0;
		elso_belepes_lesz_egyvonalba=false;
		elso_belepes_lesz_haromvonalba=true;
		voltmaregyvonal=false;
		gyorsitora_mitcsinalunk();
	}
	else if (vonalfigyeles_aktiv==true && encoder_aktualis-startpozicio > 2823) //30cm mulva ha nincs semmi akkor exit
	{
		//vonalminta=SIMA_VEZETOVONAL;
		vonalfigyeles_aktiv=false;
		haromvonalak_szama=0;
		elso_belepes_lesz_egyvonalba=false;
		elso_belepes_lesz_haromvonalba=true;
		voltmaregyvonal=false;

	}
	/*else if(vonalfigyeles_aktiv==true && encoder_aktualis-startpozicio > 2823 && haromvonalak_szama<3 ) ez az else ag erzekeny a fugakra, ki kell venni
	{
		vonalminta=LASSITO;
		//reset all
		vonalfigyeles_ignoralva=true;
		vonalfigyeles_aktiv=false;
		haromvonalak_szama=0;
		elso_belepes_lesz_egyvonalba=false;
		elso_belepes_lesz_haromvonalba=true;
		lassito_szakaszok_szama++;
		lassitora_mitcsinalunk();
	}*/

}

void lassitora_mitcsinalunk()
{
	//mmpersec_sebesseg=1550;
	if(lassito_szakaszok_szama > 2)
		fekeztunk_mar=false;
	//allapotteres_szabalyozo=NORMAL;
}
void gyorsitora_mitcsinalunk()
{
	//allapotteres_szabalyozo=GYORSITO_SZAB;
	if(elso_gyorsito)
	{
		elso_gyorsito=false;
	}
	else
	{
		mmpersec_sebesseg=850;
		eltolt_gyorsulas=true;
	}

}
/* USER CODE END 4 */

/**
  * @brief  This function is executed in case of error occurrence.
  * @param  None
  * @retval None
  */
void Error_Handler(void)
{
  /* USER CODE BEGIN Error_Handler */
  /* User can add his own implementation to report the HAL error return state */
  while(1) 
  {
  }
  /* USER CODE END Error_Handler */ 
}

#ifdef USE_FULL_ASSERT

/**
   * @brief Reports the name of the source file and the source line number
   * where the assert_param error has occurred.
   * @param file: pointer to the source file name
   * @param line: assert_param error line source number
   * @retval None
   */
void assert_failed(uint8_t* file, uint32_t line)
{
  /* USER CODE BEGIN 6 */
  /* User can add his own implementation to report the file name and line number,
    ex: printf("Wrong parameters value: file %s on line %d\r\n", file, line) */
  /* USER CODE END 6 */

}

#endif

/**
  * @}
  */ 

/**
  * @}
*/ 

/************************ (C) COPYRIGHT STMicroelectronics *****END OF FILE****/
